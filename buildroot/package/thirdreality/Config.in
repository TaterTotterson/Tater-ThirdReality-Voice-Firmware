## buildroot/package/thirdreality/Config.in
```kconfig
menu "thirdreality"
    source "package/thirdreality/pyopen-wakeword/Config.in"
    source "package/thirdreality/pyring-buffer/Config.in"
    source "package/thirdreality/amlogic-boot-fip/Config.in"
    source "package/thirdreality/broadcom/Config.in"
    source "package/thirdreality/bluez5-utils/Config.in"
    source "package/thirdreality/snapcast/Config.in"
    source "package/thirdreality/tater-linux-satellite/Config.in"
    source "package/thirdreality/python-soundcard/Config.in"
    source "package/thirdreality/python-mpv/Config.in"
    source "package/thirdreality/python-tater-protocol-compat/Config.in"
    source "package/thirdreality/python-pymicro-wakeword/Config.in"
    source "package/thirdreality/python-pymicro-features/Config.in"
    source "package/thirdreality/python-noiseprotocol/Config.in"
    source "package/thirdreality/python-chacha20poly1305-reuseable/Config.in"
    source "package/thirdreality/python-aiohappyeyeballs/Config.in"
    source "package/thirdreality/python-async-interrupt/Config.in"
    source "package/thirdreality/python-tzlocal/Config.in"
    source "package/thirdreality/python-netifaces-2/Config.in"
    source "package/thirdreality/python-getmac/Config.in"
    source "package/thirdreality/python-webrtc-noise-gain/Config.in"

    source "package/thirdreality/tr-ledring/Config.in"
    source "package/thirdreality/tater-s420-firmware/Config.in"
endmenu
```

## buildroot/package/thirdreality/onnxruntime-aarch64/Config.in
```kconfig
config BR2_PACKAGE_ONNXRUNTIME_AARCH64
	bool "onnxruntime-aarch64"
	depends on BR2_aarch64
	help
	  Prebuilt ONNX Runtime for 64-bit ARM Linux. Tater uses the C API
	  from a small native bridge to run openWakeWord without installing
	  the much larger Python runtime.
```

## buildroot/package/thirdreality/python-tater-protocol-compat/Config.in
```kconfig
config BR2_PACKAGE_PYTHON_TATER_PROTOCOL_COMPAT
	bool "Tater voice protocol compatibility schema"
	depends on BR2_PACKAGE_PYTHON3
	select BR2_PACKAGE_PYTHON_PROTOBUF
	help
	  Generated protobuf and model types used internally by the Tater
	  Linux voice state machine. Client and discovery code is pruned.
```

## buildroot/package/thirdreality/sendspin-client/Config.in
```kconfig
config BR2_PACKAGE_SENDSPIN_CLIENT
	bool "Sendspin client"
	depends on BR2_USE_MMU
	depends on BR2_USE_WCHAR
	depends on BR2_TOOLCHAIN_HAS_THREADS
	depends on BR2_INSTALL_LIBSTDCPP
	depends on !BR2_STATIC_LIBS
	depends on BR2_PACKAGE_PULSEAUDIO_HAS_ATOMIC
	select BR2_PACKAGE_AVAHI
	select BR2_PACKAGE_AVAHI_DAEMON
	select BR2_PACKAGE_AVAHI_LIBDNSSD_COMPATIBILITY
	select BR2_PACKAGE_DBUS
	select BR2_PACKAGE_PULSEAUDIO
	help
	  Headless Sendspin v1 player built from the official sendspin-cpp
	  implementation. It exposes this device to Tater, Music Assistant,
	  and other Sendspin servers with synchronized PCM/FLAC playback.

	  https://github.com/Sendspin/sendspin-cpp-cli

comment "Sendspin client needs a toolchain w/ C++, wchar, threads, dynamic library"
	depends on BR2_USE_MMU
	depends on !BR2_INSTALL_LIBSTDCPP || !BR2_USE_WCHAR \
		|| !BR2_TOOLCHAIN_HAS_THREADS || !BR2_PACKAGE_PULSEAUDIO_HAS_ATOMIC \
		|| BR2_STATIC_LIBS
```

## buildroot/package/thirdreality/tater-linux-satellite/Config.in
```kconfig
config BR2_PACKAGE_TATER_LINUX_SATELLITE
	bool "Tater Linux satellite"
	depends on BR2_PACKAGE_PYTHON3
	select BR2_PACKAGE_PYTHON_AIOESPHOMEAPI
	select BR2_PACKAGE_PYTHON_GETMAC
	select BR2_PACKAGE_PYTHON_MPV
	select BR2_PACKAGE_PYTHON_NETIFACES_2
	select BR2_PACKAGE_PYTHON_NUMPY
	select BR2_PACKAGE_PYTHON_PYBIND
	select BR2_PACKAGE_PYOPEN_WAKEWORD
	select BR2_PACKAGE_PYTHON_PYMICRO_WAKEWORD
	select BR2_PACKAGE_PYTHON_SOUNDCARD
	select BR2_PACKAGE_PYTHON_WEBSOCKETS
	select BR2_PACKAGE_PYTHON_WEBRTC_NOISE_GAIN
	select BR2_PACKAGE_PYTHON_ZEROCONF
	help
	  Tater's Linux voice satellite runtime, connected outbound through the
	  authenticated Tater native WebSocket protocol. The exact application
	  revision is pinned in tater-linux-satellite.mk.

	  https://github.com/TaterTotterson/Tater-Linux-Satellite
```

## buildroot/package/thirdreality/tater-s420-firmware/Config.in
```kconfig
config BR2_PACKAGE_TATER_S420_FIRMWARE
    bool "Tater S420 satellite firmware"
    default n
    select BR2_PACKAGE_TATER_LINUX_SATELLITE
    help
        Tater-native firmware integration for the ThirdReality S420 voice
        satellite. Installs the setup hotspot, Tater runtime supervisor,
        hardware bridge, and device audio prompts.
```
